## config/boards/shields/wackymxter/Kconfig.defconfig
```kconfig
if WACKYMXTER_LEFT

config ZMK_KEYBOARD_NAME
    default "WackyMXter"
    
config ZMK_SPLIT_ROLE_CENTRAL
    default y

endif

if WACKYMXTER_LEFT || WACKYMXTER_RIGHT

config ZMK_SPLIT
    default y

CONFIG_ZMK_KSCAN_COMPOSITE_DRIVER
    default y

endif
```

## config/boards/shields/wackymxter/Kconfig.shield
```kconfig
config WACKYMXTER_LEFT
    def_bool $(shields_list_contains,wackymxter_left)

config WACKYMXTER_RIGHT
    def_bool $(shields_list_contains,wackymxter_right)
```

## config/west.yml
```yaml
manifest:
  remotes:
    - name: zmkfirmware
      url-base: https://github.com/zmkfirmware
    - name: willwng
      url-base: https://github.com/willwng
  projects:
    - name: zmk
      remote: zmkfirmware
      revision: main
      import: app/west.yml
  self:
    path: config
```
